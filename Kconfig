## Kconfig
```kconfig
mainmenu "STM32 configuration"



menu "MCU Options"

config PLL_ON
    bool "Turn on PLL"
    default y

if PLL_ON
    choice
        prompt "Select input clock for PLL"
        default PLL_INPUT_HSI

        config PLL_INPUT_HSI
            bool "HSI"
            default y
    endchoice

    config PLLM_PRESET
        bool "Preset PLLM=2"
        default y
        help
            "It is recommended to select a frequency of 2 MHz to limit PLL jitter."

endif

config CUSTOM_SYSCLK
    bool "Set desired frequency. Default is 16MHz"
    default y
    select PLL_ON

if CUSTOM_SYSCLK
    config SYSCLK_MHZ
        int "Frequency (MHz)"
        default 16
endif

choice
    prompt "Select system voltage"
    default VOLTAGE_3_3V

    config VOLTAGE_3_3V
        bool "3.3V"
        default y

endchoice

endmenu


menu "Build Options"

source "lib/common/*/Kconfig"

endmenu


menu "Select drivers"
source "lib/drivers/*/Kconfig"
endmenu


choice
    prompt "Select test"
    default TEST_BLINK

source "tests/*/Kconfig"
endchoice
```

## lib/common/log/Kconfig
```kconfig
config COMMON_LOGGER
    bool "Use logger"
    default y
    depends on COMMON_TEST_RUNNER

config LOG_LEVEL
    int "Log level"
    default 5
    depends on COMMON_LOGGER
    help
        1 - FATAL
        2 - ERROR
        3 - WARNING
        4 - INFO
        5 - DEBUG
```

## lib/common/timer/Kconfig
```kconfig
config COMMON_TIMER
    bool "Enable TIM6 for delays"
    default y
    select DRIVER_TIMER_BASIC
```

## lib/drivers/spi/Kconfig
```kconfig
config DRIVER_SPI
    bool "SPI"
    default n
    select DRIVER_RCC
    select DRIVER_GPIO
```

## lib/drivers/timer_basic/Kconfig
```kconfig
config DRIVER_TIMER_BASIC
    bool "Basic timer"
    default n
    select DRIVER_RCC
```

## lib/drivers/uart/Kconfig
```kconfig
config DRIVER_UART
    bool "UART"
    default n
    select DRIVER_RCC
    select DRIVER_GPIO


if DRIVER_UART
    config UART_BAUD_RATE
        int "Baud rate"
        default "115200"
endif
```

## tests/i2c_ssd1306/Kconfig
```kconfig
config TEST_I2C_SSD1306
    bool "I2C SSD1306"
    default n
    select DRIVER_I2C
    select COMMON_TIMER
```

## tests/nvic/Kconfig
```kconfig
config TEST_NVIC
    bool "NVIC test"
    default n
    select DRIVER_NVIC
    select DRIVER_RCC
    select DRIVER_TIMER_BASIC
```

## tests/spi_sd/Kconfig
```kconfig
config TEST_SPI_SD
    bool "SPI SD-card test"
    default n
    select DRIVER_SPI
```

## tests/timer_basic/Kconfig
```kconfig
config TEST_TIMER_BASIC
    bool "Basic timer test"
    default n
    select DRIVER_TIMER_BASIC
    select COMMON_TEST_RUNNER
    select COMMON_TIMER
```

## tests/uart/Kconfig
```kconfig
config TEST_UART
    bool "UART"
    select DRIVER_UART
    select COMMON_TEST_RUNNER
```

## tests/voltage_check/Kconfig
```kconfig
config TEST_VOLTAGE_CHECK
    bool "Voltage check"
    default n
    select DRIVER_GPIO
```
